## conf/layer.conf
```bitbake
# We have a conf and classes directory, add to BBPATH
BBPATH .= ":${LAYERDIR}"

# We have recipes-* directories, add to BBFILES
BBFILES += "${LAYERDIR}/recipes-*/*/*.bb \
            ${LAYERDIR}/recipes-*/*/*.bbappend"

BBFILE_COLLECTIONS += "meta-ilr"
BBFILE_PATTERN_meta-ilr = "^${LAYERDIR}/"
BBFILE_PRIORITY_meta-ilr = "20"

LAYERDEPENDS_meta-ilr = "core"
LAYERSERIES_COMPAT_meta-ilr = "kirkstone mickledore"
```
